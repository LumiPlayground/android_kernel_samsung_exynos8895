## arch/arm64/Kconfig.platforms
```kconfig
menu "Platform selection"

config ARCH_SUNXI
	bool "Allwinner sunxi 64-bit SoC Family"
	select GENERIC_IRQ_CHIP
	help
	  This enables support for Allwinner sunxi based SoCs like the A64.

config ARCH_ALPINE
	bool "Annapurna Labs Alpine platform"
	select ALPINE_MSI
	help
	  This enables support for the Annapurna Labs Alpine
	  Soc family.

config ARCH_BCM_IPROC
	bool "Broadcom iProc SoC Family"
	select COMMON_CLK_IPROC
	select PINCTRL
	select ARCH_REQUIRE_GPIOLIB
	help
	  This enables support for Broadcom iProc based SoCs

config ARCH_BERLIN
	bool "Marvell Berlin SoC Family"
	select ARCH_REQUIRE_GPIOLIB
	select DW_APB_ICTL
	select PINCTRL
	help
	  This enables support for Marvell Berlin SoC Family

config ARCH_EXYNOS
	bool "ARMv8 based Samsung Exynos SoC family"
	select COMMON_CLK_SAMSUNG
	select HAVE_S3C2410_WATCHDOG if WATCHDOG
	select HAVE_S3C_RTC if RTC_CLASS
	select PINCTRL
	select PINCTRL_EXYNOS
	help
	  This enables support for ARMv8 based Samsung Exynos SoC family.

config ARCH_LAYERSCAPE
	bool "ARMv8 based Freescale Layerscape SoC family"
	help
	  This enables support for the Freescale Layerscape SoC family.

config ARCH_HISI
	bool "Hisilicon SoC Family"
	select HISILICON_IRQ_MBIGEN
	help
	  This enables support for Hisilicon ARMv8 SoC family

config ARCH_MEDIATEK
	bool "Mediatek MT65xx & MT81xx ARMv8 SoC"
	select ARM_GIC
	select PINCTRL
	select MTK_TIMER
	help
	  Support for Mediatek MT65xx & MT81xx ARMv8 SoCs

config ARCH_MESON
	bool "Amlogic Platforms"
	help
	  This enables support for the Amlogic S905 SoCs.

config ARCH_MVEBU
	bool "Marvell EBU SoC Family"
	select ARMADA_AP806_CORE_CLK
	select ARMADA_AP806_RING_CLK
	select MVEBU_ODMI
	help
	  This enables support for Marvell EBU familly, including:
	   - Armada 3700 SoC Family
	   - Armada 7K SoC Family
	   - Armada 8K SoC Family

config ARCH_QCOM
	bool "Qualcomm Platforms"
	select PINCTRL
	help
	  This enables support for the ARMv8 based Qualcomm chipsets.

config ARCH_ROCKCHIP
	bool "Rockchip Platforms"
	select ARCH_HAS_RESET_CONTROLLER
	select ARCH_REQUIRE_GPIOLIB
	select PINCTRL
	select PINCTRL_ROCKCHIP
	select ROCKCHIP_TIMER
	help
	  This enables support for the ARMv8 based Rockchip chipsets,
	  like the RK3368.

config ARCH_SEATTLE
	bool "AMD Seattle SoC Family"
	help
	  This enables support for AMD Seattle SOC Family

config ARCH_SHMOBILE
	bool

config ARCH_RENESAS
	bool "Renesas SoC Platforms"
	select ARCH_SHMOBILE
	select PINCTRL
	select PM
	select PM_GENERIC_DOMAINS
	select RENESAS_IRQC
	help
	  This enables support for the ARMv8 based Renesas SoCs.

config ARCH_R8A7795
	bool "Renesas R-Car H3 SoC Platform"
	depends on ARCH_RENESAS
	help
	  This enables support for the Renesas R-Car H3 SoC.

config ARCH_STRATIX10
	bool "Altera's Stratix 10 SoCFPGA Family"
	help
	  This enables support for Altera's Stratix 10 SoCFPGA Family.

config ARCH_TEGRA
	bool "NVIDIA Tegra SoC Family"
	select ARCH_HAS_RESET_CONTROLLER
	select ARCH_REQUIRE_GPIOLIB
	select CLKDEV_LOOKUP
	select CLKSRC_MMIO
	select CLKSRC_OF
	select GENERIC_CLOCKEVENTS
	select HAVE_CLK
	select PINCTRL
	select RESET_CONTROLLER
	help
	  This enables support for the NVIDIA Tegra SoC family.

config ARCH_SPRD
	bool "Spreadtrum SoC platform"
	help
	  Support for Spreadtrum ARM based SoCs

config ARCH_THUNDER
	bool "Cavium Inc. Thunder SoC Family"
	help
	  This enables support for Cavium's Thunder Family of SoCs.

config ARCH_UNIPHIER
	bool "Socionext UniPhier SoC Family"
	select PINCTRL
	help
	  This enables support for Socionext UniPhier SoC family.

config ARCH_VEXPRESS
	bool "ARMv8 software model (Versatile Express)"
	select ARCH_REQUIRE_GPIOLIB
	select COMMON_CLK_VERSATILE
	select POWER_RESET_VEXPRESS
	select VEXPRESS_CONFIG
	help
	  This enables support for the ARMv8 software model (Versatile
	  Express).

config ARCH_VULCAN
	bool "Broadcom Vulcan SOC Family"
	help
	  This enables support for Broadcom Vulcan SoC Family

config ARCH_XGENE
	bool "AppliedMicro X-Gene SOC Family"
	help
	  This enables support for AppliedMicro X-Gene SOC Family

config ARCH_ZYNQMP
	bool "Xilinx ZynqMP Family"
	help
	  This enables support for Xilinx ZynqMP Family

menu "Samsung Exynos"
config ARCH_EXYNOS
	bool

config SOC_EXYNOS8890
	bool "Samsung EXYNOS8890"
	select SOC_SAMSUNG
	select ARCH_EXYNOS
	select ARCH_HAS_CPUFREQ
	select HAVE_S3C2410_I2C if I2C
	select HAVE_S3C2410_WATCHDOG if WATCHDOG
	select HAVE_S3C_RTC if RTC_CLASS
	select ARCH_SUPPORTS_MSI
	select ARM_AMBA
	select CLKSRC_OF
	select USE_OF
	select COMMON_CLK_SAMSUNG
	select CLKSRC_EXYNOS_MCT
	select PINCTRL
	select SAMSUNG_DMADEV

config SOC_EXYNOS8895
	bool "Samsung EXYNOS8895"
	select SOC_SAMSUNG
	select ARCH_EXYNOS
	select ARCH_HAS_CPUFREQ
	select HAVE_S3C2410_I2C if I2C
	select HAVE_S3C2410_WATCHDOG if WATCHDOG
	select HAVE_S3C_RTC if RTC_CLASS
	select ARCH_SUPPORTS_MSI
	select ARM_AMBA
	select CLKSRC_OF
	select USE_OF
	select COMMON_CLK_SAMSUNG
	select CLKSRC_EXYNOS_MCT
	select PINCTRL
	select SAMSUNG_DMADEV

config SOC_EMULATOR8895
	bool "Samsung EMULATOR8895"

config ARCH_EXYNOS8
	bool "ARMv8 based Samsung Exynos8"
	select HAVE_ARM_SCU if SMP
	select HAVE_SMP
	help
	  Samsung EXYNOS8 (Mongoose/A53) SoC based systems

source "arch/arm64/Kconfig.projects"

menuconfig EXYNOS_DTBTOOL
	bool "Build dtbtool for Exynos"
	select DTC
	default n
	help
	  Say Y here to build the dtbtool for Exynos,
	  which is necessary to create DTB images for
	  use in Exynos boot images.

if EXYNOS_DTBTOOL

config EXYNOS_DTBH_PLATFORM_CODE
	hex "Exynos DTBH hex platform code"
	default 0x50a6
	help
	  This value is verified by the bootloader
	  to determine if the DTB image is valid for
	  the device that the kernel is booting on.

config EXYNOS_DTBH_SUBTYPE_CODE
	hex "Exynos DTBH hex subtype code"
	default 0x217584da
	help
	  This value is verified by the bootloader
	  to determine if the DTB image is valid for
	  the device that the kernel is booting on.

config EXYNOS_DTBH_PAGE_SIZE
	int "Exynos DTBH page size"
	range 2048 131072
	default 2048
	help
	  Page size used to pad the DTB image.
	  It should be equal to the page size of
	  the Exynos boot image.
	  Must be divisible by 2048.

endif

config ZONE_MOVABLE
	bool "Enable Zone Movable"
	default n

config ZONE_MOVABLE_SIZE_MBYTES
	int "ZONE_MOVABLE Size in MBytes"
	range 0 1024
	default 0
	depends on ZONE_MOVABLE
	help
	  Set Movable Zone size based on bits shift value. Movable Zone size
	  must be less than the highest populated zone.

endmenu

endmenu
```

## arch/arm64/Kconfig.projects
```kconfig
config SEC_DREAM2LTE_PROJECT
	depends on SOC_EXYNOS8895
	select EXYNOS_DTBTOOL
	bool "Samsung DREAM2LTE Project"
	help
	  Support for Samsung DREAM2LTE Project

config MACH_DREAM2LTE_EUR_OPEN
	depends on SEC_DREAM2LTE_PROJECT
	default n
	bool "Samsung DREAM2LTE EUR OPEN"
	help
	  Support for Samsung DREAM2LTE EUR OPEN device.

config MACH_DREAM2LTE_KOR_SINGLE
	depends on SEC_DREAM2LTE_PROJECT
	default n
	bool "Samsung DREAM2LTE KOR SINGLE"
	help
	  Support for Samsung DREAM2LTE KOR SINGLE device.

config SEC_DREAMLTE_PROJECT
	depends on SOC_EXYNOS8895
	select EXYNOS_DTBTOOL
	bool "Samsung DREAMLTE Project"
	help
	  Support for Samsung DREAMLTE Project

config MACH_DREAMLTE_EUR_OPEN
	depends on SEC_DREAMLTE_PROJECT
	default n
	bool "Samsung DREAMLTE EUR OPEN"
	help
	  Support for Samsung DREAMLTE EUR OPEN device.

config MACH_DREAMLTE_KOR_SINGLE
	depends on SEC_DREAMLTE_PROJECT
	default n
	bool "Samsung DREAMLTE KOR SINGLE"
	help
	  Support for Samsung DREAMLTE KOR SINGLE device.

config SEC_GREATLTE_PROJECT
	depends on SOC_EXYNOS8895
	select EXYNOS_DTBTOOL
	bool "Samsung GREATLTE Project"
	help
	  Support for Samsung GREATLTE Project

config MACH_GREATLTE_EUR_OPEN
	depends on SEC_GREATLTE_PROJECT
	default n
	bool "Samsung GREATLTE EUR OPEN"
	help
	  Support for Samsung GREATLTE EUR OPEN device.

config MACH_GREATLTE_KOR_SINGLE
	depends on SEC_GREATLTE_PROJECT
	default n
	bool "Samsung GREATLTE KOR SINGLE"
	help
	  Support for Samsung GREATLTE KOR SINGLE device.
```

## drivers/bts/Kconfig
```kconfig
#
# BTS driver configuration
#

menuconfig EXYNOS_BTS
	bool "BTS driver support"
	default y
	help
	  Enable BTS (Bus traffic shaper) support

if EXYNOS_BTS

config EXYNOS8895_BTS
	bool "Bus traffic shaper support"
	default y
	depends on SOC_EXYNOS8895
	help
	  Enable BTS (Bus traffic shaper) support
endif
```

## drivers/crypto/fmp/Kconfig
```kconfig
config FMP_UFS
	tristate "Samsung EXYNOS FMP Driver for UFS"
	depends on SCSI_UFSHCD && SCSI_UFSHCD_PLATFORM
	depends on UFS_FMP_DM_CRYPT || UFS_FMP_EXT4CRYPT_FS
	---help---
	  This is EXYNOS FMP UFS driver.

	  It is enabled automatically when any UFS FMP feature is enabled.

config FMP_MMC
	tristate "Samsung EXYNOS FMP Driver for MMC"
	depends on MMC_DW
	depends on MMC_DW_FMP_DM_CRYPT || MMC_DW_FMP_EXT4CRYPT_FS
	---help---
	  This is EXYNOS FMP MMC driver.

	  It is enabled automatically when any MMC FMP feature is enabled.

config FMP_DM_CRYPT
	tristate "Samsung EXYNOS FMP DM_CRYPT Driver"
        depends on DM_CRYPT
	depends on UFS_FMP_DM_CRYPT || MMC_DW_FMP_DM_CRYPT
	---help---
	  This is EXYNOS FMP DM_CRYPT driver.

	  It is enabled automatically when any FMP DM_CRYPT feature is enabled.

config FMP_EXT4CRYPT_FS
	tristate "Samsung EXYNOS FMP Ext4Crypt FS ENcryption Driver"
        depends on EXT4_FS_ENCRYPTION
	depends on UFS_FMP_EXT4CRYPT_FS || MMC_DW_FMP_EXT4CRYPT_FS
	---help---
	  This is EXYNOS FMP Ext4Crypt FS ENCRYPTION driver.

	  It is enabled automatically when any Ext4Crypt FMP FS feature is enabled.

config FIPS_FMP
	tristate "Samsung EXYNOS FMP Validation Driver for FIPS"
	depends on FMP_UFS
	depends on !FUNCTION_TRACER
	---help---
	  This selects Samsung EXYNOS FMP Validation driver for FIPS.

	  If you have a controller with this interface, say Y here.

	  If unsure, say N.
```

## drivers/power/Kconfig
```kconfig
source "drivers/power/supply/Kconfig"
source "drivers/power/reset/Kconfig"
source "drivers/power/avs/Kconfig"
```

## drivers/sensorhub/Kconfig
```kconfig
#
# sensor drivers configuration
#

comment "Sensor hub configs"

config SENSORS_SSP
	tristate "Sensors ssp"
	default n
	depends on SPI
	help
	  ssp driver for sensor hub.
	  If you say yes here you get ssp support for
	  sensor hub.
	  To compile this driver as a module, choose M here: the
	  module will be called ssp.

config SENSORS_SSP_BBD
	tristate "Sensors ssp brcm"
	default n
	depends on SENSORS_SSP
	help
	  ssp driver for brcm sensor hub.
	  If you say yes here you get ssp support for
	  brcm sensor hub.

if SENSORS_SSP_BBD
source "drivers/sensorhub/brcm/Kconfig"
endif # SENSORS_SSP_BBD
```

## fs/crypto/Kconfig
```kconfig
config FS_ENCRYPTION
	bool "FS Encryption (Per-file encryption)"
	depends on BLOCK
	select CRYPTO
	select CRYPTO_AES
	select CRYPTO_CBC
	select CRYPTO_ECB
	select CRYPTO_XTS
	select CRYPTO_CTS
	select CRYPTO_SHA512
	select CRYPTO_HMAC
	select KEYS
	select ENCRYPTED_KEYS
	help
	  Enable encryption of files and directories.  This
	  feature is similar to ecryptfs, but it is more memory
	  efficient since it avoids caching the encrypted and
	  decrypted pages in the page cache.  Currently Ext4,
	  F2FS make use of this feature.
```
